## main/Kconfig.projbuild
```kconfig
menu "Xiaozhi AI"

config XIAOZHI_AI_OTA_URL
    string "Xiaozhi activation URL"
    default "http://192.168.18.17:8002/xiaozhi/ota/"
    help
        Official XiaoZhi activation endpoint. The weather-clock OTA service is not affected.

endmenu
```
